## meta-ostro/conf/distro/ostro.conf
```bitbake
DISTRO = "ostro"
DISTRO_NAME = "Ostro OS"
# The version is bumped after each official release.
# This implies that new releases go out with a version
# string based on the predecessor plus the suffix, which
# was deemed sufficient in the "[Ostro-dev] versioning Ostro OS"
# mail thread.
DISTRO_VERSION = "1.0+snapshot-${DATE}"
DISTRO_VERSION[vardepsexclude] = "DATE"
SDK_VENDOR = "-ostrosdk"
SDK_VERSION := "${@'${DISTRO_VERSION}'.replace('snapshot-${DATE}','snapshot')}"
SDK_NAME_PREFIX = "ostro"
SDK_UPDATE_URL = "${OSTRO_SDK_UPDATE_URL}"

# SDK_UPDATE_URL defines the eSDK updateserver configured in
# devtool.conf when populate-sdk-ext is run.
#
# Example SDK_UPDATE_URLs are:
# https://download.ostroproject.org/builds/ostro-os/latest/sdk-data/<machine> OR
# https://download.ostroproject.org/releases/ostro-os/milestone/<release>/sdk-data/<machine>
#
# The default setting can be overridded in local.conf
OSTRO_SDK_UPDATE_URL ??= "https://download.ostroproject.org/builds/ostro-os/latest/sdk-data/${MACHINE}"

# Extensible SDK configuration: Ostro uses "minimal" type which minimizes the size of the downloaded
# SDK itself and configures devtool to use SSTATE_MIRROR (defined in o sdk-extra.conf).
# The package data available gets recorded. This has the side-effect that exporting the eSDK
# for a certain image will not only cover the image, but also all packages that ared included
# in a world build, and for doing that it will build all these packages.
SDK_EXT_TYPE = "minimal"
SDK_INCLUDE_PKGDATA = "1"

# Set custom tasks from Ostro layers as recursive dependencies to do_populate_sdk.
SDK_RECRDEP_TASKS = "do_deploy_files do_uefiapp"

# Blacklist inherited classes that break proper data restore from SSTATE when populating the SDK.
SDK_INHERIT_BLACKLIST = "buildhistory icecc buildhistory-extra buildstats-summary archiver isafw test-iot"

# The variable BB_NUMBER_PARSE_THREADS set in CI in order to
# limit the number of parse threads should not leak to the user's
# environment since it may increase SDK installation time and
# worsen runtime performance on capable systems.
SDK_LOCAL_CONF_BLACKLIST_append = " BB_NUMBER_PARSE_THREADS"

# Disable SSTATE locked sigs checks. SDK_INHERIT_BLACKLISTed classes
# used in CI (and mirrored SSTATE) cause locked signature file check
# failures with eSDK installation. Until the blacklisted classes are
# fixed, SSTATE checks need to be run in self-tests.
SIGGEN_LOCKEDSIGS_TASKSIG_CHECK = "none"

# When building in a CI system with swupd enabled, OS_VERSION must be
# set to a consistent value for all builds. See ostroproject-ci.inc
# for an example how that works with Jenkins.
#
# In local builds, we only have ${DATETIME} as something that
# increments automatically, but it is too large for an integer number
# on 32 bit systems. Therefore we substract the 2016 as the initial
# year in which Ostro OS started using swupd and ignore the
# seconds.
#
# The default behavior is to not rebuild just because OS_VERSION
# changed. If that is desired, include in local.conf:
#   VERSION_ID = "${OS_VERSION}"
# This will cause the os-release package to be rebuilt each time
# OS_VERSION changes, and that in turn causes an image and bundle
# rebuild.
#
# For more predictable results is possible to set OS_RELEASE manually,
# either in local.conf or in the environment like this:
#   BB_ENV_EXTRAWHITE="$BB_ENV_EXTRAWHITE OS_VERSION" OS_VERSION=110 bitbake ...
OS_VERSION ?= "${@ str(((int('${DATETIME}') - 20160000000000) / 100) * 10) }"
OS_VERSION[vardepsexclude] += "DATETIME"

# Ostro OS tries to build minimal images and thus prefers Busybox or
# Toybox over coreutils or any other package providing similar
# functionality. For technical reasons, this is crucial when building
# swupd bundles: Busybox/Toybox must be picked consistently, even when
# a bundle pulls in alternatives like coreutils which normally would
# have a higher priority.
#
# This gets achieved in two ways:
# 1. via ostro-update-alternatives.bbclass we modify all packages
#    so that their update-alternatives priority can be modified
#    during install time
# 2. in ostro-image.bbclass we reconfigure those priorities
#    as necessary
#
# This is still a change that is done consistently for all images,
# whether they use swupd or not, to ensure that the result is
# identical. Doing it at image creation time reduces the need
# for recompilations of packages and opens up the possibility
# for downstream developers to override the defaults while
# reusing pre-compiled binaries from our sstate.
INHERIT += "ostro-update-alternatives"

MAINTAINER = "Ostro Dev <ostro-dev@lists.ostroproject.org>"

TARGET_VENDOR = "-ostro"

OSTRO_DEFAULT_DISTRO_FEATURES = "systemd bluez5 pam"
OSTRO_DEFAULT_EXTRA_RDEPENDS ??= ""
OSTRO_DEFAULT_EXTRA_RRECOMMENDS ??= ""

# Smack security is a distribution feature which can be enabled or
# disabled as needed. To simplify recipes, there is also a smack
# override.
#
# At the moment, these settings must be kept in sync manually: the
# "smack" override must be set if and only if the "smack" distro
# feature is set.
#
# In other words, to disable the default in a local.conf, change two variables
# like this:
#  OSTRO_SMACK_OVERRIDE = ""
#  OSTRO_DEFAULT_DISTRO_FEATURES_remove = "smack"

OSTRO_DEFAULT_DISTRO_FEATURES += "smack"
OSTRO_SMACK_OVERRIDE ?= ":smack"
DISTROOVERRIDES .= "${OSTRO_SMACK_OVERRIDE}"

# IMA/EVM depend on compiling some components (currently the kernel)
# differently. This distro feature enables that.
OSTRO_DEFAULT_DISTRO_FEATURES += "ima"

# ptests are useful for QA. Enabling them in the distro creates
# additional packages in each recipe that supports ptests and thus
# allows building images with those tests included. Enabling ptests
# should have no effect on normal packages; if there is an effect,
# then that is a bug in the recipe.
OSTRO_DEFAULT_DISTRO_FEATURES += "ptest"

# Remove currently unsupported distro features from global defaults
DISTRO_FEATURES_DEFAULT_remove = "x11 3g"

DISTRO_FEATURES ?= "${DISTRO_FEATURES_DEFAULT} ${DISTRO_FEATURES_LIBC} ${OSTRO_DEFAULT_DISTRO_FEATURES}"

# Currently Ostro OS is still using swupd 2.x because that is what
# has been tested with most. The newer 3.x will be tested right after
# the initial swupd integration.
PREFERRED_VERSION_swupd-client ?= "2.%"
PREFERRED_VERSION_swupd-client-native ?= "2.%"
PREFERRED_VERSION_swupd-server ?= "2.%"
PREFERRED_VERSION_swupd-server-native ?= "2.%"

# Use 4.4 kernel for meta-intel BSP MACHINEs
# BeagleBone is still on 4.1 until meta-yocto-bsp switches it over
PREFERRED_VERSION_linux-yocto_intel-corei7-64 ?= "4.4%"
PREFERRED_VERSION_linux-yocto_intel-quark ?= "4.4%"
PREFERRED_VERSION_linux-yocto_beaglebone ?= "4.1%"

# Use UEFI-based "dsk" image format for machines supporting UEFI.
# Defined here because it influences several different recipes.
OSTRO_USE_DSK_IMAGES ?= "${@bb.utils.contains_any('MACHINE', 'intel-core2-32 intel-corei7-64 intel-quark', 'True', 'False', d)}"

DISTRO_EXTRA_RDEPENDS += " ${OSTRO_DEFAULT_EXTRA_RDEPENDS}"
DISTRO_EXTRA_RRECOMMENDS += " ${OSTRO_DEFAULT_EXTRA_RRECOMMENDS}"

QEMU_TARGETS ?= "arm i386 x86_64"

# Set PREMIRRORS to prioritize Ostro OS autobuilder source cache.
# The OSTRO_SOURCE_MIRROR_URL can be overriden in local.conf.
OSTRO_SOURCE_MIRROR_URL ??= "https://download.ostroproject.org/mirror/sources/"
SOURCE_MIRROR_URL = "${OSTRO_SOURCE_MIRROR_URL}"
INHERIT += "own-mirrors"

VIRTUAL-RUNTIME_init_manager = "systemd"
VIRTUAL-RUNTIME_initscripts = ""
DISTRO_FEATURES_BACKFILL_CONSIDERED = "sysvinit pulseaudio"

require conf/distro/include/no-static-libs.inc
require conf/distro/include/ostro_security_flags.inc

# Build distro stateless, i.e. with /etc empty straight out of the box
# and reserved for customizations by the admin.
require conf/distro/include/stateless.inc

# QA check settings - a little stricter than the OE-Core defaults
WARN_TO_ERROR_QA = "already-stripped compile-host-path install-host-path \
                    installed-vs-shipped ldflags pn-overrides rpaths staticdev \
                    useless-rpaths build-deps"
WARN_QA_remove = "${WARN_TO_ERROR_QA}"
ERROR_QA_append = " ${WARN_TO_ERROR_QA}"

# Add some Ostro OS specific checks in addition to those provided by sanity.bbclass.
INHERIT += "ostro-sanity"

# Only specific recipes from the layers in meta-openembedded are
# supported in combination with Ostro OS, even though all of
# meta-openembedded gets imported into the combined repository.
#
# To use recipes from meta-openembedded, they must be added to the
# respective PNWHITELIST variables, here for officially supported ones
# or in a local.conf for inofficial ones in a personal build (_append,
# += and = all work in a local.conf).
#
# To remove white-listing of a layer (i.e. enable all of its recipes),
# remove the layer from PNWHITELIST_LAYERS.
#
# Note that bblayer.conf.sample only adds layers which have enabled
# recipes. Add or remove layers there as needed when changing the white
# lists below.
INHERIT += "whitelist"
PNWHITELIST_REASON = "not supported by the ${DISTRO_NAME} (not on the whitelist)"

PNWHITELIST_LAYERS = " \
    efl-layer \
    filesystems-layer \
    gnome-layer \
    gpe-layer \
    meta-initramfs \
    meta-python \
    multimedia-layer \
    networking-layer \
    openembedded-layer \
    perl-layer \
    ruby-layer \
    systemd-layer \
    toolchain-layer \
    webserver \
    xfce-layer \
    meta-java \
    meta-soletta \
"

# Using += here so that we extend an earlier value from local.conf
# instead of overwriting it.
PNWHITELIST_efl-layer += ""
PNWHITELIST_filesystems-layer += ""
PNWHITELIST_gnome-layer += " \
    libidl \
"
PNWHITELIST_gpe-layer += ""
PNWHITELIST_meta-initramfs += ""
PNWHITELIST_meta-python += " \
    python-m2crypto-native \
    python-lxml-native \
"
PNWHITELIST_multimedia-layer += ""
PNWHITELIST_networking-layer += " \
    iftop \
    lowpan-tools \
    traceroute \
"
PNWHITELIST_openembedded-layer += " \
    atop \
    can-utils \
    dash \
    giflib \
    gmock \
    gtest \
    htop \
    iotop \
    krb5 \
    libsocketcan \
    pkcs11-helper \
    vim \
    acpica-native \
    libxaw \
    xterm \
    twm \
"
PNWHITELIST_perl-layer += ""
PNWHITELIST_ruby-layer += ""
PNWHITELIST_systemd-layer += ""
PNWHITELIST_toolchain-layer += ""
PNWHITELIST_webserver += ""
PNWHITELIST_xfce-layer += ""
PNWHITELIST_meta-java += " \
    openjdk-8 \
    openjre-8 \
    icedtea7-native \
    ant-native \
    rhino-native \
    ecj-bootstrap-native \
    libecj-bootstrap-native \
    jikes-initial-native \
    jikes-native \
    ecj-initial-native \
    cacao-native \
    cacao-initial-native \
    classpath-native \
    fastjar-native \
    jsch-native \
    bsf-native \
    xalan-j-native \
    xerces-j-native \
    xml-commons-resolver1.1-native \
    classpath \
    gnumail-native \
    gnujaf-native \
    bcel-native \
    regexp-native \
    log4j1.2-native \
    antlr-native \
    oro-native \
    junit-native \
    jdepend-native \
    commons-net-native \
    commons-logging-native \
    jzlib-native \
    jacl-native \
    jlex-native \
    cup-native \
    jaxp1.3-native \
    inetlib-native \
    servlet2.3-native \
    logkit-native \
    avalon-framework-api-native \
"
PNWHITELIST_meta-soletta += " \
    soletta \
    soletta-dev-app \
    libmicrohttpd \
    lss \
    python3-jsonschema \
    python3-jsonschema-native \
    graphviz \
"

# Java bootstrapping
PREFERRED_PROVIDER_virtual/java-initial-native = "cacao-initial-native"
PREFERRED_PROVIDER_virtual/java-native = "cacao-native"
PREFERRED_PROVIDER_virtual/javac-native = "ecj-bootstrap-native"

# Now the inverse operations for certain recipes from layers like
# OE-core where whitelisting would not be efficient (too many recipes
# would have to be listed).

INHERIT += "blacklist"
PNBLACKLIST[beecrypt] = "Use rpm5 internal beecrypt, not supported."
PNBLACKLIST[unfs3] = "Not supported."
PNBLACKLIST[lms7] = "Not supported."
PNBLACKLIST[sato-icom-theme] = "Not supported."
PNBLACKLIST[traceroute] = "Not supported."
PNBLACKLIST[createrepo] = "Not supported."
PNBLACKLIST[directfb] = "Not supported."
PNBLACKLIST[directfb-examples] = "Not supported."
PNBLACKLIST[packagegroup-core-directfb] = "Not supported."
PNBLACKLIST[packagegroup-core-full-cmdline] = "Not supported."
PNBLACKLIST[lighttpd] = "Not supported."
PNBLACKLIST[mailx] = "Not supported."
PNBLACKLIST[pcmciautils] = "Not supported."
PNBLACKLIST[ppp-dialin] = "Not supported."
PNBLACKLIST[apmd] = "Not supported."
PNBLACKLIST[subversion] = "Not supported."
PNBLACKLIST[sysklogd] = "Not supported."
PNBLACKLIST[syslinux] = "Not supported."
PNBLACKLIST[wayland] = "Not supported."
PNBLACKLIST[systemd-serialgetty] = "Replaced by systemd's systemd-getty-generator"
PNBLACKLIST[initramfs-live-install-testfs] = "DEPENDS on grub which is PNBLACKLISTed, not supported."
PNBLACKLIST[initramfs-live-install] = "DEPENDS on grub which is PNBLACKLISTed, not supported."
PNBLACKLIST[grub] = "World build fails on beaglebone."
PNBLACKLIST[u-boot-tools-edison] = "World build fails, not supported."
PNBLACKLIST[u-boot-fw-utils] = "World build fails, not supported."
PNBLACKLIST[iotivity-sensorboard] = "World build fails with a linker error, not supported."
PNBLACKLIST[xuser-account] = "Cannot be built due to missing group, not supported."
PNBLACKLIST[sysstat] = "Cannot be built due to missing group, not supported."
PNBLACKLIST[builder] = "Cannot be built due to missing group, not supported."
PNBLACKLIST[pulseaudio] = "Cannot be built due to missing audio group, not supported."
PNBLACKLIST[gnome-desktop3] = "Cannot be built due to missing graphics stack, not supported."
PNBLACKLIST[epiphany] = "Cannot be built due to missing graphics stack, not supported."
PNBLACKLIST[connman-gnome] = "Cannot be built due to missing gtk+, not supported."
PNBLACKLIST[gtk-engines] = "Cannot be built due to missing gtk+, not supported."
PNBLACKLIST[gst-player] = "Cannot be built due to missing gtk+, not supported."
PNBLACKLIST[matchbox-terminal] = "Cannot be built due to missing gtk+, not supported."
PNBLACKLIST[matchbox-session-sato] = "Cannot be built due to missing gtk+, not supported."
PNBLACKLIST[matchbox-desktop] = "Cannot be built due to missing gtk+, not supported."
PNBLACKLIST[matchbox-panel] = "Cannot be built due to missing gtk+, not supported."
PNBLACKLIST[matchbox-panel-2] = "Cannot be built due to missing gtk+, not supported."
PNBLACKLIST[matchbox-keyboard] = "Cannot be built due to missing gtk+, not supported."
PNBLACKLIST[matchbox-config-gtk] = "Cannot be built due to missing gtk+, not supported."
PNBLACKLIST[packagegroup-core-x11-sato] = "Cannot be built due to missing gtk+, not supported."
PNBLACKLIST[gtk-sato-engine] = "Cannot be built due to missing gtk+, not supported."
PNBLACKLIST[sato-screenshot] = "Cannot be built due to missing gtk+, not supported."
PNBLACKLIST[kernelshark] = "Cannot be built due to missing gtk+, not supported."
PNBLACKLIST[python-pygtk] = "Cannot be built due to missing gtk+, not supported."
PNBLACKLIST[gtk-theme-torturer] = "Cannot be built due to missing gtk+, not supported."
PNBLACKLIST[sysprof] = "Cannot be built due to missing gtk+, not supported."
PNBLACKLIST[libglade] = "Cannot be built due to missing gtk+, not supported."
PNBLACKLIST[avahi-ui] = "Cannot be built due to missing gtk+, not supported."
PNBLACKLIST[oprofileui] = "Cannot be built due to missing gtk+, not supported."
PNBLACKLIST[libfm] = "Cannot be built due to missing gtk+, not supported."
PNBLACKLIST[pcmanfm] = "Cannot be built due to missing gtk+, not supported."
PNBLACKLIST[clutter-1.0] = "Cannot be built due to missing virtual/egl, not supported."
PNBLACKLIST[eglinfo-fb] = "Cannot be built due to missing virtual/egl, not supported."
PNBLACKLIST[mesa-demos] = "Cannot be built due to missing virtual/egl, not supported."
PNBLACKLIST[libva] = "${@bb.utils.contains('DISTRO_FEATURES', 'opengl', '', 'Cannot be built due to missing virtual/egl, not supported.', d)}"
PNBLACKLIST[weston] = "Cannot be built due to missing virtual/egl, not supported."
PNBLACKLIST[cogl-1.0] = "Cannot be built due to missing virtual/libglesv2, not supported."
PNBLACKLIST[clutter-gtk-1.0] = "Cannot be built due to missing clutter-1.0, not supported."
PNBLACKLIST[clutter-gst-3.0] = "Cannot be built due to missing clutter-1.0, not supported."
PNBLACKLIST[mx-1.0] = "Cannot be built due to missing clutter-1.0, not supported."
PNBLACKLIST[libwnck3] = "Cannot be built due to missing libxres, not supported."
PNBLACKLIST[gstreamer-vaapi-1.0] = "${@bb.utils.contains('DISTRO_FEATURES', 'opengl', '', 'Cannot be built due to missing libva, not supported.', d)}"
PNBLACKLIST[libva-intel-driver] = "${@bb.utils.contains('DISTRO_FEATURES', 'opengl', '', 'Cannot be built due to missing libva, not supported.', d)}"
PNBLACKLIST[gcr] = "Cannot be built due to missing gtk+3, not supported."
PNBLACKLIST[packagegroup-core-clutter] = "RDEPENDS on unavailable clutter-1.0/clutter-gst-3.0/clutter-gtk-1.0, not supported."
PNBLACKLIST[va-intel] = "${@bb.utils.contains('DISTRO_FEATURES', 'opengl', '', 'Cannot be built due to missing libva, not supported.', d)}"
PNBLACKLIST[weston-init] = "RDEPENDS on unavailable weston/weston-init-dev, not supported."
PNBLACKLIST[python-pycairo] = "Cannot be built due to missing cairo, not supported"
PNBLACKLIST[packagegroup-core-directfb] = "Cannot be built due to missing pango, not supported"
PNBLACKLIST[bootchart2] = "Cannot be built due to missing python-pycairo, not supported"
PNBLACKLIST[gstreamer1.0-rtsp-server] = "Cannot be built due to missing gstreamer1.0-plugins-base, not supported"
PNBLACKLIST[packagegroup-self-hosted] = "Requires sysstat, not supported"
PNBLACKLIST[packagegroup-core-lsb] = "Requires sysstat, not supported"
PNBLACKLIST[packagegroup-core-tools-profile] = "Requires sysstat, not supported"
PNBLACKLIST[packagegroup-core-tools-testapps] = "Requires gst-player-bin, not supported"
PNBLACKLIST[packagegroup-core-device-devel] = "Cannot be built due to missing gtk+, not supported."
PNBLACKLIST[packagegroup-core-x11-base] = "Cannot be built due to missing gtk+, not supported."
PNBLACKLIST[webkitgtk] = "Cannot be built due to missing gtk+, not supported."
PNBLACKLIST[piglit] = "Cannot be built due to unsupported mesa-demos."
PNBLACKLIST[alsa-tools] = "Cannot be built due to missing gtk+, not supported."
PNBLACKLIST[puzzles] = "Cannot be built due to missing gtk+, not supported."
PNBLACKLIST[oh-puzzles] = "Cannot be built due to missing gtk+, not supported."
PNBLACKLIST[settings-daemon] = "Cannot be built due to missing gtk+, not supported."
PNBLACKLIST[fstests] = "Cannot be built due to missing gtk+, not supported."
PNBLACKLIST[leafpad] = "Cannot be built due to missing gtk+, not supported."
PNBLACKLIST[latencytop] = "Cannot be built due to missing gtk+, not supported."
PNBLACKLIST[libowl] = "Cannot be built due to missing gtk+, not supported."
PNBLACKLIST[classpath] = "Cannot be built due to missing gtk+, not supported."
PNBLACKLIST[distcc] = "Cannot be built due to missing gtk+, not supported."
PNBLACKLIST[distcc-config] = "Cannot be built due to missing gtk+, not supported."

# Edison still uses it (for now) and builds its own modified version,
# which conflicts with other machines if we were to also build it there.
PNBLACKLIST_INITRAMFS_BOOT_edison = ""
PNBLACKLIST_INITRAMFS_BOOT = "Only used on Edison."
PNBLACKLIST[initramfs-boot] = "${PNBLACKLIST_INITRAMFS_BOOT}"

# Fixes pending upstream, disabled here because we don't need them.
PNBLACKLIST[lttng-tools] = "Has undesired machine-dependency"
PNBLACKLIST[meta-ide-support] = "Has undesired machine-dependency"
PNBLACKLIST[oprofile] = "Has undesired machine-dependency"
PNBLACKLIST[oprofileui-server] = "Has undesired machine-dependency"
RDEPENDS_packagegroup-core-device-devel_remove_pn-packagegroup-core-device-devel = "oprofileui-server"
RDEPENDS_packagegroup-core-tools-profile_remove_pn-packagegroup-core-tools-profile = "lttng-tools"

# meta-intel-iot-middleware unbuildable or otherwise broken recipes
PNBLACKLIST[mdns] = "World build fails, not supported."
PNBLACKLIST[c-ares] = "Fails to build with security C flags, not supported."
PNBLACKLIST[hid-api] = "Not supported."
PNBLACKLIST[tempered] = "Not supported."
PNBLACKLIST[libwyliodrin] = "Cannot be build due to blacklisted hiredis"
PNBLACKLIST[wyliodrin-server] = "Cannot be build due to blacklisted jansson"
PNBLACKLIST[hiredis] = "Depends on unavailable redis"
PNBLACKLIST[xdk-daemon] = "Depends on unavailable libarchive-bin"
PNBLACKLIST[parse-embedded-sdks] = "Invalid LICENSE format"
PNBLACKLIST[python-pyfirmata] = "RDEPENDS on unavailable python-pyserial"
PNBLACKLIST[python-serial] = "Cannot be built, not supported."

# Disable certain components which are in meta-intel-iot-security, but
# which we do not want in the image anymore.
PNBLACKLIST[app-runas] = "obsolete"
PNBLACKLIST[security-manager] = "obsolete"
PNBLACKLIST[cynara] = "obsolete"
PNBLACKLIST[dbus-cynara] = "obsolete"
PNBLACKLIST[dlog] = "obsolete"
PNBLACKLIST[libslp-db-util] = "obsolete"
PNBLACKLIST[tizen-platform-config] = "obsolete"
PNBLACKLIST[tizen-platform-wrapper] = "obsolete"
PNBLACKLIST[packagegroup-security-framework] = "unused"

# It is uncertain whether rhino is really an allarch package. It's signature
# is different among machines, causing the iotsstatetests.SStateTests.test_sstate_samesigs
# to fail. We play it save here and make the recipe specific to the tune flags.
# Needs further investigations by upstream.
PACKAGE_ARCH_pn-rhino = "${TUNE_PKGARCH}"

# Set a proper filter to classify internal vs. external patches (only internal
# patches are of interest) in the patch summary created by inputanalyzer.
INPUTANALYZER_WHITELIST = '/(meta|meta-yocto-bsp|meta-intel|meta-java|meta-oic|meta-oe|meta-networking|meta-python|meta-intel-iot-middleware|meta-security-isafw)/*$ ^$'

# re-use uninative shim released by Yocto Project / OE
require conf/distro/include/yocto-uninative.inc
INHERIT += "uninative"

# Disable running fsck at boot. System clock is typically wrong at early boot
# stage due to lack of RTC backup battery. This causes unnecessary fixes being
# made due to filesystem metadata time stamps being in future.
APPEND_append = " fsck.mode=skip"

# skip swupd-server from world build because of a build failure. Only
# swupd-server-native is used so this is a safe choice.
# The failure is: "autoreconf execution failed."
EXCLUDE_FROM_WORLD_pn-swupd-server = "1"

# soletta-dev-app breaks builds in CI due to npm install and network
# problems with it. Temporarily skip the build.
EXCLUDE_FROM_WORLD_pn-soletta-dev-app = "1"

# The plugin fails to compile against glibc in OE-core master:
# error: 'soup_session_async_new_with_options' is deprecated: Use 'soup_session_new' instead [-Werror=deprecated-declarations]
# We do not need gsignond yet, so disable building it unless someone explicitly asks for it.
EXCLUDE_FROM_WORLD_pn-gsignond-plugin-oauth = "1"
# And gsignond itself simply is not needed yet, so also disable the rest.
EXCLUDE_FROM_WORLD_pn-gsignond = "1"
EXCLUDE_FROM_WORLD_pn-gsignond-plugin-sasl = "1"
```
