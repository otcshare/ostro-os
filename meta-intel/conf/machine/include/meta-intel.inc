## meta-intel/conf/machine/include/meta-intel.inc
```bitbake
#
# BSP variables and settings specific to the meta-intel layer.
# You must include the meta-intel layer in your bblayers.conf
# to use them.
#

#
# XSERVER subcomponents, used to build the XSERVER variable
#

PREFERRED_PROVIDER_virtual/kernel ?= "linux-yocto"
PREFERRED_VERSION_linux-yocto ?= "4.4%"

# for Xserver older than 1.13.0
OLD_XSERVER_X86_EXT = "xserver-xorg-extension-dri \
           xserver-xorg-extension-dri2 \
           xserver-xorg-extension-extmod \
           xserver-xorg-extension-dbe \
           "

XSERVER_X86_MATROX_MGA = "xf86-video-mga \
           "

XSERVER_X86_ASPEED_AST = "xf86-video-ast \
           "

# include the user space intel microcode loading support in the generated images.
MACHINE_ESSENTIAL_EXTRA_RDEPENDS_append = "${@bb.utils.contains('MACHINE_FEATURES', 'intel-ucode', ' intel-microcode', '', d)}"

# for the early boot time kernel microcode loading support,
# merge the microcode data in the final initrd image.
INITRD_LIVE_prepend = "${@bb.utils.contains('MACHINE_FEATURES', 'intel-ucode', '${DEPLOY_DIR_IMAGE}/microcode.cpio ', '', d)}"
```

## meta-intel/conf/machine/intel-core2-32.conf
```bitbake
#@TYPE: Machine
#@NAME: intel-core2-32

#@DESCRIPTION: Machine configuration for 32 bit Intel Core 2 CPU (and later) with MMX, SSE, SSE2, SSE3, and SSSE3 instruction set support. Supports a moderately wide range of drivers that should boot and be usable on "typical" hardware.

require conf/machine/include/meta-intel.inc
require conf/machine/include/intel-core2-32-common.inc
require conf/machine/include/intel-common-pkgarch.inc

PREFERRED_PROVIDER_virtual/kernel ?= "linux-yocto"
PREFERRED_VERSION_linux-yocto ?= "4.1%"

MACHINE_FEATURES += "pcbios efi"
MACHINE_FEATURES += "va-impl-intel"
MACHINE_FEATURES += "wifi 3g nfc"
MACHINE_FEATURES += "intel-ucode"

MACHINE_HWCODECS ?= "va-intel gstreamer-vaapi-1.0"

MACHINE_EXTRA_RRECOMMENDS += "linux-firmware"

MACHINE_ESSENTIAL_EXTRA_RRECOMMENDS += "gma500-gfx-check"

XSERVER ?= "${XSERVER_X86_BASE} \
            ${XSERVER_X86_EXT} \
            ${XSERVER_X86_FBDEV} \
            ${XSERVER_X86_I915} \
            ${XSERVER_X86_I965} \
            ${XSERVER_X86_MODESETTING} \
            ${XSERVER_X86_VESA} \
           "

SYSLINUX_OPTS = "serial 0 115200"
SERIAL_CONSOLES = "115200;ttyS0 115200;ttyPCH0"
APPEND += "console=ttyS0,115200 console=ttyPCH0,115200 console=tty0"
```

## meta-intel/conf/machine/intel-corei7-64.conf
```bitbake
#@TYPE: Machine
#@NAME: intel-corei7-64

#@DESCRIPTION: Machine configuration for 64 bit Intel Core i7 CPU (and later) with MMX, SSE, SSE2, SSE3, and SSSE3 instruction set support. Supports a moderately wide range of drivers that should boot and be usable on "typical" hardware.

require conf/machine/include/meta-intel.inc
require conf/machine/include/intel-corei7-64-common.inc
require conf/machine/include/intel-common-pkgarch.inc

MACHINE_FEATURES += "pcbios efi"
MACHINE_FEATURES += "va-impl-intel"
MACHINE_FEATURES += "wifi 3g nfc"
MACHINE_FEATURES += "intel-ucode"

MACHINE_HWCODECS ?= "va-intel gstreamer1.0-vaapi"

MACHINE_EXTRA_RRECOMMENDS += "lms8"

XSERVER ?= "${XSERVER_X86_BASE} \
            ${XSERVER_X86_EXT} \
            ${XSERVER_X86_FBDEV} \
            ${XSERVER_X86_I915} \
            ${XSERVER_X86_I965} \
            ${XSERVER_X86_MATROX_MGA} \
            ${XSERVER_X86_MODESETTING} \
            ${XSERVER_X86_VESA} \
            ${XSERVER_X86_ASPEED_AST} \
           "

SYSLINUX_OPTS = "serial 0 115200"
SERIAL_CONSOLES = "115200;ttyS0 115200;ttyS1 115200;ttyS2"
APPEND += "rootwait console=ttyS0,115200 console=tty0"

PACKAGE_INSTALL_append_pn-core-image-minimal-initramfs = " linux-firmware-i915"

IMAGE_FSTYPES += "wic"
WKS_FILE ?= "systemd-bootdisk-uuid.wks"
do_image_wic[depends] += "gptfdisk-native:do_populate_sysroot mtools-native:do_populate_sysroot dosfstools-native:do_populate_sysroot"
```

## meta-intel/conf/machine/intel-quark.conf
```bitbake
#@TYPE: Machine
#@NAME: quark

#@DESCRIPTION: Machine configuration for Quark systems

require conf/machine/include/meta-intel.inc
require conf/machine/include/intel-quark-common.inc
require conf/machine/include/intel-common-pkgarch.inc

#Avoid pulling in GRUB
MACHINE_ESSENTIAL_EXTRA_RDEPENDS = ""

MACHINE_FEATURES = "efi usb"
MACHINE_FEATURES += "intel-ucode"

MACHINE_EXTRA_RRECOMMENDS += "kernel-modules linux-firmware"

SERIAL_CONSOLE = "115200 ttyS1"
APPEND += "console=ttyS1,115200 console=tty0"

EFI_PROVIDER = "gummiboot"

# Ensure that the Lock prefix is omitted for the kernel"
KERNEL_EXTRA_ARGS = "EXTRA_CFLAGS=-Wa,-momit-lock-prefix=yes"
```

## meta-intel/scripts/lib/wic/canned-wks/systemd-bootdisk-tiny32.wks
```
# short-description: Create an EFI disk image with systemd-boot and core2-32
# long-description: Creates a partitioned EFI disk image that the user
# can directly dd to boot media. The selected bootloader is systemd-boot.
# This disk image is meant to be used by core2-32 and core-image-tiny-initramfs

part /boot --source bootimg-efi --sourceparams="loader=systemd-boot,initrd=core-image-tiny-initramfs-intel-core2-32.cpio.gz" --ondisk sda --label msdos --active --align 1024

bootloader --ptable gpt --timeout=5 --append="init=/bin/busybox sh init console=ttyS0,115200 console=tty0 rw LABEL=boot debugshell=5"
```

## meta-java/conf/layer.conf
```bitbake
# We have a conf and classes directory, append to BBPATH
BBPATH .= ":${LAYERDIR}"

# We have a recipes directory, add to BBFILES
BBFILES += "${LAYERDIR}/recipes*/*/*.bb ${LAYERDIR}/recipes*/*/*.bbappend"

BBFILE_COLLECTIONS += "meta-java"
BBFILE_PATTERN_meta-java := "^${LAYERDIR}/"
BBFILE_PRIORITY_meta-java = "10"
```

## meta-oic/conf/layer.conf
```bitbake
# We have a conf and classes directory, add to BBPATH
BBPATH .= ":${LAYERDIR}"

# We have recipes-* directories, add to BBFILES
BBFILES += "${LAYERDIR}/recipes-*/*/*.bb \
           "
#            ${LAYERDIR}/recipes-*/*/*.bbappend"

BBFILE_COLLECTIONS += "oic"
BBFILE_PATTERN_oic := "^${LAYERDIR}/"
BBFILE_PRIORITY_oic = "6"

#
# Switch to bluez5 
#
#DISTRO_FEATURES_append = " bluez5"
#PREFERRED_PROVIDER_bluez-hcidump = "bluez5"
#PNBLACKLIST[bluez-hcidump] = "superseded by bluez5"
#PNBLACKLIST[gst-plugin-bluetooth] = "dropped from bluez5"
#PNBLACKLIST[bluez4] = "superseded by bluez5"
```

## meta-ostro/conf/bblayers.conf.sample
```bitbake
# LAYER_CONF_VERSION is increased each time build/conf/bblayers.conf
# changes incompatibly
LCONF_VERSION = "8"

BBPATH = "${TOPDIR}"
BBFILES ?= ""

OSTRO_LAYERS = " \
  ##OEROOT##/meta-ostro-fixes \
  ##OEROOT##/meta \
  ##OEROOT##/meta-selftest \
  ##OEROOT##/meta-intel \
  ##OEROOT##/meta-ostro \
  ##OEROOT##/meta-oic \
  ##OEROOT##/meta-intel-iot-security/meta-security-smack \
  ##OEROOT##/meta-intel-iot-security/meta-security-framework \
  ##OEROOT##/meta-intel-iot-security/meta-integrity \
  ##OEROOT##/meta-intel-iot-middleware \
  ##OEROOT##/meta-ostro-bsp \
  ##OEROOT##/meta-ostro-bsp/meta-edison-bsp \
  ##OEROOT##/meta-iot-web \
  ##OEROOT##/meta-yocto/meta-yocto-bsp \
  ##OEROOT##/meta-iotqa \
  ##OEROOT##/meta-appfw \
  ##OEROOT##/meta-security-isafw \
  ##OEROOT##/meta-swupd \
  "

# The following layers are available in the combined repository.
# Their recipes are filtered via white-listing in ostro.conf,
# i.e. even if the layer gets added, only explicitly listed recipes
# are enabled. Enable layers here only if they have enabled recipes
# to avoid warnings about empty layers.

# OSTRO_LAYERS += "##OEROOT##/meta-openembedded/meta-efl"
# OSTRO_LAYERS += "##OEROOT##/meta-openembedded/meta-filesystems"
# OSTRO_LAYERS += "##OEROOT##/meta-openembedded/meta-gnome"
# OSTRO_LAYERS += "##OEROOT##/meta-openembedded/meta-gpe"
# OSTRO_LAYERS += "##OEROOT##/meta-openembedded/meta-initramfs"
# OSTRO_LAYERS += "##OEROOT##/meta-openembedded/meta-multimedia"
OSTRO_LAYERS += "##OEROOT##/meta-openembedded/meta-networking"
OSTRO_LAYERS += "##OEROOT##/meta-openembedded/meta-oe"
# OSTRO_LAYERS += "##OEROOT##/meta-openembedded/meta-perl"
OSTRO_LAYERS += "##OEROOT##/meta-openembedded/meta-python"
# OSTRO_LAYERS += "##OEROOT##/meta-openembedded/meta-ruby"
# OSTRO_LAYERS += "##OEROOT##/meta-openembedded/meta-systemd"
# OSTRO_LAYERS += "##OEROOT##/meta-openembedded/meta-webserver"
# OSTRO_LAYERS += "##OEROOT##/meta-openembedded/meta-xfce"
# OSTRO_LAYERS += "##OEROOT##/meta-openembedded/toolchain-layer"
OSTRO_LAYERS += "##OEROOT##/meta-java"
OSTRO_LAYERS += "##OEROOT##/meta-soletta"

BBLAYERS ?= "${OSTRO_LAYERS}"

# toaster uses this hint to decide whether it let's the user
# remove a layer from BBLAYERS. All layers which provide something
# that is required to build ostro-image should be listed here.
# We do not really track that, so add all layers also here.
BBLAYERS_NON_REMOVABLE ?= "${OSTRO_LAYERS}"
```

## meta-ostro/conf/distro/include/ostro-os-development.inc
```bitbake
# Use the pre-generated keys for IMA signing.
IMA_EVM_KEY_DIR = "${IMA_EVM_BASE}/data/debug-keys"

# Enable local root access. Always use _append, to
# avoid getting this change overwritten by a
# OSTRO_IMAGE_EXTRA_FEATURES = "foo" in local.conf.
OSTRO_IMAGE_EXTRA_FEATURES_append = " autologin"

# Mark images as "development" by extending /etc/motd.
OSTRO_EXTRA_MOTD () {
************************************
*** This is a development image! ***
*** Do not use in production.    ***
************************************
}

# Everything ready, avoid initial sanity check.
OSTRO_IMAGE_BUILD_MODE_SELECTED = "1"

# Test build
OSTRO_IMAGE_EXTRA_INSTALL_append = " librealsense-examples"
```

## meta-ostro/conf/distro/include/ostro_security_flags.inc
```bitbake
# Include security flags pulled in via openembedded-core.
require conf/distro/include/security_flags.inc

SECURITY_PIC_CFLAGS ?= "-fpic"

# Add Ostro OS specific flags to fix build issues with
# recipes that are being used in Ostro OS.
SECURITY_CFLAGS_pn-zeromq = "${SECURITY_NO_PIE_CFLAGS} ${SECURITY_PIC_CFLAGS}"
SECURITY_CFLAGS_pn-mraa = "${SECURITY_NO_PIE_CFLAGS} ${SECURITY_PIC_CFLAGS}"
SECURITY_CFLAGS_pn-upm = "${SECURITY_NO_PIE_CFLAGS} ${SECURITY_PIC_CFLAGS}"
SECURITY_CFLAGS_pn-iot-app-fw = "${SECURITY_NO_PIE_CFLAGS} ${SECURITY_PIC_CFLAGS}"
SECURITY_CFLAGS_pn-iotivity = "${SECURITY_NO_PIE_CFLAGS} ${SECURITY_PIC_CFLAGS}"
SECURITY_CFLAGS_pn-krb5 = "${SECURITY_NO_PIE_CFLAGS} ${SECURITY_PIC_CFLAGS}"

# openjdk-8 ends up linking with "-shared -pie -fpie" in some cases (see
# hotspot/make/linux/makefiles/saproc.make) which then tries (and fails) to
# produce an executable instead of a shared object because main() is
# undefined.
SECURITY_CFLAGS_pn-openjdk-8 = "${SECURITY_NO_PIE_CFLAGS}"
SECURITY_CFLAGS_pn-openjre-8 = "${SECURITY_NO_PIE_CFLAGS}"

# Additional exceptions for packages in Ostro OS which do not
# compile with -Wformat-security as error (sorted alphabetically).
SECURITY_STRINGFORMAT_pn-dash = ""
SECURITY_STRINGFORMAT_pn-giflib = ""
SECURITY_STRINGFORMAT_pn-gsignond = ""
SECURITY_STRINGFORMAT_pn-openjdk-8 = ""
SECURITY_STRINGFORMAT_pn-openjre-8 = ""
```

## meta-ostro/conf/distro/include/ostroproject-ci.inc
```bitbake
#
# https://ostroproject.org/jenkins CI configuration:
# This file applied via conf/auto.conf for every build
# happening in Ostro Project CI
#

#
# Static section
# Items that are always present in any CI build:
#

# Generate summary statistics
INHERIT += "buildstats-summary"

# Enable CVE and other security checks.
INHERIT += "isafw"

# Most of the images are expected to contain GPLv3
# components. Therefore we only enable the license check for those
# which must not have them (whitelisting), instead of excluding images
# from the check (blacklisting).
ISAFW_LA_PLUGIN_IMAGE_WHITELIST = "ostro-image-minimal ostro-initramfs"

# ostro-image-minimal is only getting built below as proof that an Ostro OS root
# filesystem is possible without depending on GPLv3 components. The actual
# image files are not needed for that.
IMAGE_FSTYPES_pn-ostro-image-minimal = ""
OSTRO_VM_IMAGE_TYPES_pn-ostro-image-minimal = ""

# Enable extended buildhistory:
INHERIT += "buildhistory"
BUILDHISTORY_COMMIT = "1"
INHERIT += "buildhistory-extra"

# Test data generation:
INHERIT += "test-iot"
TEST_EXPORT_DIR = "iottest"
TEST_TARGET = "simpleremote"

# SDK defaults:
SDKMACHINE ?= "x86_64"

# Generate source mirror tarballs:
BB_GENERATE_MIRROR_TARBALLS = "1"

# Configure images in "development mode".
require conf/distro/include/ostro-os-development.inc

# XXX Drop the VM hack after taking care also of the non UEFI devices
# (those using U-Boot: edison and beaglebone)
OSTRO_VM_IMAGE_TYPES = "dsk.xz dsk.zip dsk.ova dsk.bmap dsk.xz.sha256sum"

#
# Automated build targets
# Those targets should be space separated list of items,
# which must contain only alphanumeric symbols,'-' and '_'.
# Any other symbols would be skipped in parser.
#
# Following targets would be used to perform default build task:
OSTROPROJECT_CI_BUILD_TARGETS="ostro-image-noswupd ostro-image-swupd ostro-image-swupd-dev ostro-image-minimal"
# Following targets would be executed with do_populate_sdk task
OSTROPROJECT_CI_SDK_TARGETS=""
# Following targets would be executed with do_populate_sdk_ext task.
# Uses the fully-populated image to ensure that the eSDK is as complete
# as possible.
OSTROPROJECT_CI_ESDK_TARGETS="ostro-image-swupd-all"
# Following targets would be executed with do_test_iot_export task
OSTROPROJECT_CI_TEST_EXPORT_TARGETS="ostro-image-swupd-dev"
# Execute automatic tests for following images with corresponding
# test suite and test files.
# Space separated list of tuples, each should in format:
# <image_name>,<testsuite_name>,<testfiles_name>,$MACHINE
OSTROPROJECT_CI_TEST_RUNS="ostro-image-swupd-dev,iot-testsuite.tar.gz,iot-testfiles.${MACHINE}.tar.gz,${MACHINE}"

# In the CI system, the integer OS version used for swupd is derived
# from the Jenkins build number part of the BUILD_ID. The conversion
# to int and back to string acts as sanity check that we really get a
# number out of the BUILD_ID.
#
# BUILD_ID is expected to have this format:
# BUILD_ID = "<parent-build-timestamp (of Jenkins top job)>" + "-build-" + "<jenkins-top-job-build-number>"
#
# We multiply it by ten, to ensure that the version space has some gap
# for minor updates. How to actually build minor updates with Jenkins
# still needs to be determined.
OS_VERSION ?= "${@ str(int('${BUILD_ID}'.split('-')[-1]) * 10) }"

#
# Dymamic section.
# Values are applied dynamically based on runtime config or builder host
# parameters.
# Present here as reference only.
#

# Explicit machine declaration by build job:
# MACHINE = "$TARGET_MACHINE"

# Shared download directory between builders:
# DL_DIR = "/srv/bb-cache/ostro-os/sources"

# Limit CPU utilization, based on amount of slots/CPU cores
# on builder hosts:
# BB_NUMBER_PARSE_THREADS = "X"
# BB_NUMBER_THREADS = "X"
# PARALLEL_MAKE = "-j X"

# Local optimizations on SSTATE directories, shared between builder hosts:
# SSTATE_MIRRORS ?= "file://.* http://$IP/bb-cache/ostro-os/sstate/PATH"
# SSTATE_DIR ?= "/var/tmp/sstate-$slot"

# Local directory, where builder puts local copy of buildhistory
# BUILDHISTORY_DIR ?="$WORKSPACE/buildhistory"

# PRserv host dynamically allocated by master:
# PRSERV_HOST = "$IP:$PORT"

# Enabled for master release builds:
# INHERIT += "archiver"
# ARCHIVER_MODE[src] = "original"
# ARCHIVER_MODE[diff] = "1"
# ARCHIVER_MODE[recipe] = "1"
```
